## configs/jumpnow_bbb_defconfig
```kconfig
BR2_arm=y
BR2_cortex_a8=y
BR2_DL_DIR="$(HOME)/dl"
BR2_CCACHE=y
BR2_GLOBAL_PATCH_DIR="board/jumpnow/bbb/patches"
BR2_TOOLCHAIN_BUILDROOT_GLIBC=y
BR2_PACKAGE_HOST_LINUX_HEADERS_CUSTOM_4_9=y
BR2_TOOLCHAIN_BUILDROOT_CXX=y
BR2_TARGET_GENERIC_HOSTNAME="bbb"
BR2_INIT_SYSV=y
BR2_ROOTFS_DEVICE_CREATION_DYNAMIC_EUDEV=y
BR2_TARGET_GENERIC_ROOT_PASSWD="jumpnowtek"
BR2_TARGET_GENERIC_GETTY_BAUDRATE_115200=y
BR2_SYSTEM_DHCP="eth0"
BR2_TARGET_TZ_INFO=y
BR2_TARGET_LOCALTIME="EST5EDT"
BR2_ROOTFS_OVERLAY="board/jumpnow/bbb/rootfs_overlay"
BR2_ROOTFS_POST_BUILD_SCRIPT="board/jumpnow/bbb/post-build.sh"
BR2_ROOTFS_POST_IMAGE_SCRIPT="board/jumpnow/bbb/post-image.sh"
BR2_LINUX_KERNEL=y
BR2_LINUX_KERNEL_CUSTOM_GIT=y
BR2_LINUX_KERNEL_CUSTOM_REPO_URL="git://git.kernel.org/pub/scm/linux/kernel/git/stable/linux-stable.git"
BR2_LINUX_KERNEL_CUSTOM_REPO_VERSION="4ad5dcaca7428dd2bc1a6a40c948e3799c1e27ae"
BR2_LINUX_KERNEL_PATCH="board/jumpnow/bbb/linux/4.9"
BR2_LINUX_KERNEL_USE_CUSTOM_CONFIG=y
BR2_LINUX_KERNEL_CUSTOM_CONFIG_FILE="board/jumpnow/bbb/linux/4.9/defconfig"
BR2_LINUX_KERNEL_DTS_SUPPORT=y
BR2_LINUX_KERNEL_INTREE_DTS_NAME="am335x-boneblack am335x-bonegreen am335x-bonegreen-wireless bbb-hdmi bbb-nohdmi bbb-4dcape43t bbb-4dcape70t bbb-nh5cape bbb-nhd7cape"
BR2_PACKAGE_SERIALECHO=y
BR2_PACKAGE_GETTEXT=y
BR2_PACKAGE_OBSIDIAN_CURSORS=y
BR2_PACKAGE_BITSTREAM_VERA=y
BR2_PACKAGE_DEJAVU=y
BR2_PACKAGE_INCONSOLATA=y
BR2_PACKAGE_LIBERATION=y
BR2_PACKAGE_PYTOUCH=y
BR2_PACKAGE_TSPRESS=y
BR2_PACKAGE_FBSET=y
BR2_PACKAGE_QT5=y
BR2_PACKAGE_QT5BASE_GUI=y
BR2_PACKAGE_QT5BASE_DEFAULT_QPA="linuxfb"
BR2_PACKAGE_QT5BASE_FONTCONFIG=y
BR2_PACKAGE_QT5BASE_GIF=y
BR2_PACKAGE_QT5BASE_JPEG=y
BR2_PACKAGE_QT5BASE_PNG=y
BR2_PACKAGE_QT5BASE_ICU=y
BR2_PACKAGE_QT5BASE_TSLIB=y
BR2_PACKAGE_QT5SERIALBUS=y
BR2_PACKAGE_LINUX_FIRMWARE=y
BR2_PACKAGE_LINUX_FIRMWARE_TI_WL18XX=y
BR2_PACKAGE_I2C_TOOLS=y
BR2_PACKAGE_PYTHON3=y
BR2_PACKAGE_PYTHON3_SQLITE=y
BR2_PACKAGE_PYTHON_NUMPY=y
BR2_PACKAGE_PYTHON_PYQT5=y
BR2_PACKAGE_PYTHON_SERIAL=y
BR2_PACKAGE_PYTHON_SPIDEV=y
BR2_PACKAGE_LIBEVDEV=y
BR2_PACKAGE_LIBEVENT=y
BR2_PACKAGE_ETHTOOL=y
BR2_PACKAGE_IPERF3=y
BR2_PACKAGE_IPROUTE2=y
BR2_PACKAGE_IW=y
BR2_PACKAGE_OPENSSH=y
BR2_PACKAGE_WIRELESS_TOOLS=y
BR2_PACKAGE_WPA_SUPPLICANT=y
BR2_PACKAGE_WPA_SUPPLICANT_AUTOSCAN=y
BR2_PACKAGE_WPA_SUPPLICANT_DEBUG_SYSLOG=y
BR2_PACKAGE_WPA_SUPPLICANT_CLI=y
BR2_PACKAGE_WPA_SUPPLICANT_PASSPHRASE=y
BR2_PACKAGE_BASH=y
BR2_PACKAGE_PROCPS_NG=y
BR2_PACKAGE_VIM=y
# BR2_PACKAGE_VIM_RUNTIME is not set
BR2_TARGET_ROOTFS_EXT2=y
BR2_TARGET_ROOTFS_EXT2_4=y
BR2_TARGET_ROOTFS_EXT2_SIZE="1966080"
BR2_TARGET_UBOOT=y
BR2_TARGET_UBOOT_BUILD_SYSTEM_KCONFIG=y
BR2_TARGET_UBOOT_CUSTOM_VERSION=y
BR2_TARGET_UBOOT_CUSTOM_VERSION_VALUE="2017.05"
BR2_TARGET_UBOOT_PATCH="board/jumpnow/bbb/patches/u-boot"
BR2_TARGET_UBOOT_BOARD_DEFCONFIG="am335x_boneblack"
BR2_TARGET_UBOOT_NEEDS_DTC=y
# BR2_TARGET_UBOOT_FORMAT_BIN is not set
BR2_TARGET_UBOOT_FORMAT_IMG=y
BR2_TARGET_UBOOT_SPL=y
BR2_TARGET_UBOOT_SPL_NAME="MLO"
BR2_PACKAGE_HOST_DOSFSTOOLS=y
BR2_PACKAGE_HOST_GENIMAGE=y
BR2_PACKAGE_HOST_MTOOLS=y
```

## configs/jumpnow_duovero_defconfig
```kconfig
BR2_arm=y
BR2_cortex_a9=y
BR2_ARM_ENABLE_NEON=y
BR2_ARM_FPU_NEON=y
BR2_DL_DIR="$(HOME)/dl"
BR2_CCACHE=y
BR2_GLOBAL_PATCH_DIR="board/jumpnow/duovero/patches"
BR2_TOOLCHAIN_BUILDROOT_GLIBC=y
BR2_PACKAGE_HOST_LINUX_HEADERS_CUSTOM_4_9=y
BR2_TOOLCHAIN_BUILDROOT_CXX=y
BR2_TARGET_GENERIC_HOSTNAME="duovero"
BR2_INIT_SYSV=y
BR2_ROOTFS_DEVICE_CREATION_DYNAMIC_EUDEV=y
BR2_TARGET_GENERIC_ROOT_PASSWD="jumpnowtek"
BR2_TARGET_GENERIC_GETTY_BAUDRATE_115200=y
BR2_SYSTEM_DHCP="eth0"
BR2_TARGET_TZ_INFO=y
BR2_TARGET_LOCALTIME="EST5EDT"
BR2_ROOTFS_OVERLAY="board/jumpnow/duovero/rootfs_overlay"
BR2_ROOTFS_POST_BUILD_SCRIPT="board/jumpnow/duovero/post-build.sh"
BR2_ROOTFS_POST_IMAGE_SCRIPT="board/jumpnow/duovero/post-image.sh"
BR2_LINUX_KERNEL=y
BR2_LINUX_KERNEL_CUSTOM_GIT=y
BR2_LINUX_KERNEL_CUSTOM_REPO_URL="git://git.kernel.org/pub/scm/linux/kernel/git/stable/linux-stable.git"
BR2_LINUX_KERNEL_CUSTOM_REPO_VERSION="0eed54bdbd1b922004fe05dc8bf3815f2e5723d7"
BR2_LINUX_KERNEL_PATCH="board/jumpnow/duovero/linux/4.9"
BR2_LINUX_KERNEL_USE_CUSTOM_CONFIG=y
BR2_LINUX_KERNEL_CUSTOM_CONFIG_FILE="board/jumpnow/duovero/linux/4.9/defconfig"
BR2_LINUX_KERNEL_DTS_SUPPORT=y
BR2_LINUX_KERNEL_INTREE_DTS_NAME="omap4-duovero-parlor"
BR2_PACKAGE_SERIALECHO=y
BR2_PACKAGE_GETTEXT=y
BR2_PACKAGE_LINUX_FIRMWARE=y
BR2_PACKAGE_LINUX_FIRMWARE_MWIFIEX_SD8787=y
BR2_PACKAGE_I2C_TOOLS=y
BR2_PACKAGE_PYTHON3=y
BR2_PACKAGE_PYTHON3_SQLITE=y
BR2_PACKAGE_PYTHON_SERIAL=y
BR2_PACKAGE_PYTHON_SPIDEV=y
BR2_PACKAGE_LIBEVDEV=y
BR2_PACKAGE_LIBEVENT=y
BR2_PACKAGE_ETHTOOL=y
BR2_PACKAGE_IPERF3=y
BR2_PACKAGE_IW=y
BR2_PACKAGE_OPENSSH=y
BR2_PACKAGE_WIRELESS_TOOLS=y
BR2_PACKAGE_WPA_SUPPLICANT=y
BR2_PACKAGE_PROCPS_NG=y
BR2_PACKAGE_VIM=y
# BR2_PACKAGE_VIM_RUNTIME is not set
BR2_TARGET_ROOTFS_EXT2=y
BR2_TARGET_ROOTFS_EXT2_4=y
BR2_TARGET_ROOTFS_EXT2_SIZE="1966080"
BR2_TARGET_UBOOT=y
BR2_TARGET_UBOOT_BUILD_SYSTEM_KCONFIG=y
BR2_TARGET_UBOOT_CUSTOM_VERSION=y
BR2_TARGET_UBOOT_CUSTOM_VERSION_VALUE="2017.05"
BR2_TARGET_UBOOT_PATCH="board/jumpnow/duovero/patches/u-boot"
BR2_TARGET_UBOOT_BOARD_DEFCONFIG="duovero"
# BR2_TARGET_UBOOT_FORMAT_BIN is not set
BR2_TARGET_UBOOT_FORMAT_IMG=y
BR2_TARGET_UBOOT_SPL=y
BR2_TARGET_UBOOT_SPL_NAME="MLO"
BR2_PACKAGE_HOST_DOSFSTOOLS=y
BR2_PACKAGE_HOST_DTC=y
BR2_PACKAGE_HOST_GENIMAGE=y
BR2_PACKAGE_HOST_MTOOLS=y
```

## configs/jumpnow_rpi3_defconfig
```kconfig
BR2_arm=y
BR2_cortex_a7=y
BR2_ARM_FPU_NEON_VFPV4=y
BR2_DL_DIR="$(HOME)/dl"
BR2_CCACHE=y
BR2_TOOLCHAIN_BUILDROOT_GLIBC=y
BR2_PACKAGE_HOST_LINUX_HEADERS_CUSTOM_4_9=y
BR2_TOOLCHAIN_BUILDROOT_CXX=y
BR2_INIT_SYSV=y
BR2_ROOTFS_DEVICE_CREATION_DYNAMIC_EUDEV=y
BR2_TARGET_GENERIC_ROOT_PASSWD="jumpnowtek"
BR2_SYSTEM_DHCP="eth0"
BR2_TARGET_TZ_INFO=y
BR2_TARGET_LOCALTIME="EST5EDT"
BR2_ROOTFS_OVERLAY="board/jumpnow/rpi3/rootfs_overlay"
BR2_ROOTFS_POST_BUILD_SCRIPT="board/jumpnow/rpi3/post-build.sh"
BR2_ROOTFS_POST_IMAGE_SCRIPT="board/jumpnow/rpi3/post-image.sh"
BR2_LINUX_KERNEL=y
BR2_LINUX_KERNEL_CUSTOM_GIT=y
BR2_LINUX_KERNEL_CUSTOM_REPO_URL="https://github.com/raspberrypi/linux.git"
BR2_LINUX_KERNEL_CUSTOM_REPO_VERSION="12bafdab8214b23223603b75845c5c88f7444b6f"
BR2_LINUX_KERNEL_PATCH="board/jumpnow/rpi/linux/4.9"
BR2_LINUX_KERNEL_DEFCONFIG="bcm2709"
BR2_LINUX_KERNEL_DTS_SUPPORT=y
BR2_LINUX_KERNEL_INTREE_DTS_NAME="bcm2709-rpi-2-b bcm2710-rpi-3-b bcm2710-rpi-cm3"
BR2_LINUX_KERNEL_DTS_OVERLAYS_SUPPORT=y
BR2_PACKAGE_MCP3008_POLL=y
BR2_PACKAGE_MCP3008_SPEEDTEST=y
BR2_PACKAGE_SERIALECHO=y
BR2_PACKAGE_GETTEXT=y
BR2_PACKAGE_OBSIDIAN_CURSORS=y
BR2_PACKAGE_BITSTREAM_VERA=y
BR2_PACKAGE_DEJAVU=y
BR2_PACKAGE_INCONSOLATA=y
BR2_PACKAGE_LIBERATION=y
BR2_PACKAGE_PYTOUCH=y
BR2_PACKAGE_TSPRESS=y
BR2_PACKAGE_FBSET=y
BR2_PACKAGE_QT5=y
BR2_PACKAGE_QT53D=y
BR2_PACKAGE_QT5BASE_SQLITE_QT=y
BR2_PACKAGE_QT5BASE_LINUXFB=y
BR2_PACKAGE_QT5BASE_EGLFS=y
BR2_PACKAGE_QT5BASE_DEFAULT_QPA="eglfs"
BR2_PACKAGE_QT5BASE_FONTCONFIG=y
BR2_PACKAGE_QT5BASE_GIF=y
BR2_PACKAGE_QT5BASE_JPEG=y
BR2_PACKAGE_QT5BASE_PNG=y
BR2_PACKAGE_QT5BASE_ICU=y
BR2_PACKAGE_QT5BASE_TSLIB=y
BR2_PACKAGE_QT5IMAGEFORMATS=y
BR2_PACKAGE_QT5MULTIMEDIA=y
BR2_PACKAGE_QT5SENSORS=y
BR2_PACKAGE_QT5SERIALBUS=y
BR2_PACKAGE_QT5WEBSOCKETS=y
BR2_PACKAGE_RPI_FIRMWARE=y
BR2_PACKAGE_RPI_FIRMWARE_X=y
BR2_PACKAGE_RPI_FIRMWARE_INSTALL_VCDBG=y
BR2_PACKAGE_RPI_WIFI_FIRMWARE=y
BR2_PACKAGE_I2C_TOOLS=y
BR2_PACKAGE_PYTHON3=y
BR2_PACKAGE_PYTHON3_SQLITE=y
BR2_PACKAGE_PYTHON_NUMPY=y
BR2_PACKAGE_PYTHON_PAHO_MQTT=y
BR2_PACKAGE_PYTHON_PYQT5=y
BR2_PACKAGE_PYTHON_SERIAL=y
BR2_PACKAGE_PYTHON_SPIDEV=y
BR2_PACKAGE_SQLITE_NO_SYNC=y
BR2_PACKAGE_LIBEVDEV=y
BR2_PACKAGE_IPERF=y
BR2_PACKAGE_IPROUTE2=y
BR2_PACKAGE_IW=y
BR2_PACKAGE_NTP=y
BR2_PACKAGE_OPENSSH=y
BR2_PACKAGE_WPA_SUPPLICANT=y
BR2_PACKAGE_WPA_SUPPLICANT_AP_SUPPORT=y
BR2_PACKAGE_WPA_SUPPLICANT_WIFI_DISPLAY=y
BR2_PACKAGE_BASH=y
BR2_PACKAGE_PROCPS_NG=y
BR2_PACKAGE_VIM=y
# BR2_PACKAGE_VIM_RUNTIME is not set
BR2_TARGET_ROOTFS_EXT2=y
BR2_TARGET_ROOTFS_EXT2_4=y
BR2_TARGET_ROOTFS_EXT2_SIZE="1966080"
# BR2_TARGET_ROOTFS_TAR is not set
BR2_PACKAGE_HOST_DOSFSTOOLS=y
BR2_PACKAGE_HOST_GENIMAGE=y
BR2_PACKAGE_HOST_MTOOLS=y
```

## configs/mbay_rpi3_defconfig
```kconfig
BR2_GCC_TARGET_FLOAT_ABI="hard"
BR2_GCC_TARGET_FPU="neon-vfpv4"
BR2_GCC_TARGET_MODE="arm"
BR2_GCC_VERSION="6.4.0"
BR2_GCC_VERSION_6_X=y
BR2_GENERATE_LOCALE=""
BR2_GLOBAL_PATCH_DIR=""
BR2_INIT_SYSV=y
BR2_INSTALL_LIBSTDCPP=y
BR2_JLEVEL=0
BR2_KERNEL_HEADERS_AS_KERNEL=y
BR2_OPTIMIZE_S=y
BR2_PACKAGE_GLIBC=y
BR2_PACKAGE_HOST_LINUX_HEADERS_CUSTOM_4_9=y
BR2_PACKAGE_LINUX_HEADERS=y
BR2_PACKAGE_OVERRIDE_FILE="$(CONFIG_DIR)/local.mk"
BR2_READELF_ARCH_NAME="ARM"
BR2_ROOTFS_DEVICE_CREATION_DYNAMIC_EUDEV=y
BR2_ROOTFS_DEVICE_TABLE="system/device_table.txt"
BR2_ROOTFS_OVERLAY="board/mbay/rpi3/rootfs_overlay"
BR2_ROOTFS_POST_BUILD_SCRIPT="board/mbay/rpi3/post-build.sh"
BR2_ROOTFS_POST_FAKEROOT_SCRIPT=""
BR2_ROOTFS_POST_IMAGE_SCRIPT="board/mbay/rpi3/post-image.sh"
BR2_ROOTFS_POST_SCRIPT_ARGS=""
BR2_ROOTFS_SKELETON_DEFAULT=y
BR2_ROOTFS_USERS_TABLES=""
BR2_SHARED_LIBS=y
BR2_SSP_NONE=y
BR2_STRIP_EXCLUDE_DIRS=""
BR2_STRIP_EXCLUDE_FILES=""
BR2_STRIP_strip=y
BR2_SYSTEM_BIN_SH_BUSYBOX=y
BR2_SYSTEM_DHCP="eth0"
BR2_TARGET_ENABLE_ROOT_LOGIN=y
BR2_TARGET_GENERIC_GETTY_BAUDRATE="0"
BR2_TARGET_GENERIC_GETTY_BAUDRATE_KEEP=y
BR2_TARGET_GENERIC_GETTY_OPTIONS=""
BR2_TARGET_GENERIC_GETTY_PORT="console"
BR2_TARGET_GENERIC_GETTY_TERM="vt100"
BR2_TARGET_GENERIC_GETTY=y
BR2_TARGET_GENERIC_HOSTNAME="buildroot"
BR2_TARGET_GENERIC_ISSUE="Welcome to Buildroot"
BR2_TARGET_GENERIC_PASSWD_MD5=y
BR2_TARGET_GENERIC_PASSWD_METHOD="md5"
BR2_TARGET_GENERIC_REMOUNT_ROOTFS_RW=y
BR2_TARGET_GENERIC_ROOT_PASSWD="testpass"
BR2_TARGET_LDFLAGS=""
BR2_TARGET_LOCALTIME="EST5EDT"
BR2_TARGET_OPTIMIZATION=""
BR2_TARGET_TZ_INFO=y
BR2_TARGET_TZ_ZONELIST="default"
BR2_TOOLCHAIN_BUILDROOT_CXX=y
BR2_TOOLCHAIN_BUILDROOT_GLIBC=y
BR2_TOOLCHAIN_BUILDROOT_LIBC="glibc"
BR2_TOOLCHAIN_BUILDROOT_VENDOR="buildroot"
BR2_TOOLCHAIN_BUILDROOT=y
BR2_TOOLCHAIN_USES_GLIBC=y
BR2_TOOLCHAIN=y
BR2_USE_MMU=y
BR2_USE_WCHAR=y

# LINUX KERNEL SETUP
BR2_LINUX_KERNEL=y
BR2_LINUX_KERNEL_CUSTOM_GIT=y
BR2_LINUX_KERNEL_CUSTOM_REPO_URL="https://github.com/raspberrypi/linux.git"
BR2_LINUX_KERNEL_CUSTOM_REPO_VERSION="a6d7c7353dfd938f8f5c6d6f33813f2c4b3ff7dc"
BR2_LINUX_KERNEL_PATCH="board/mbay/rpi/linux/4.9"
BR2_LINUX_KERNEL_DEFCONFIG="bcm2709"
BR2_LINUX_KERNEL_DTS_SUPPORT=y
BR2_LINUX_KERNEL_INTREE_DTS_NAME="bcm2710-rpi-3-b bcm2710-rpi-cm3"
BR2_LINUX_KERNEL_DTS_OVERLAYS_SUPPORT=y

# LINUX WIFI FIRMWARE
BR2_PACKAGE_LINUX_FIRMWARE=y
BR2_PACKAGE_LINUX_FIRMWARE_BRCM_BCM43XXX=y

# BASIC SYSTEM PACKAGES
BR2_PACKAGE_MCP3008_POLL=y
BR2_PACKAGE_MCP3008_SPEEDTEST=y
BR2_PACKAGE_RPI_FIRMWARE=y
BR2_PACKAGE_RPI_FIRMWARE_X=y
BR2_PACKAGE_RPI_FIRMWARE_INSTALL_VCDBG=y
BR2_PACKAGE_RPI_WIFI_FIRMWARE=y
BR2_PACKAGE_I2C_TOOLS=y
BR2_PACKAGE_LIBEVDEV=y
BR2_PACKAGE_IPERF=y
BR2_PACKAGE_IPROUTE2=y
BR2_PACKAGE_IW=y
BR2_PACKAGE_NTP=y
BR2_PACKAGE_NTP_NTPD=y
BR2_PACKAGE_WPA_SUPPLICANT=y
BR2_PACKAGE_WPA_SUPPLICANT_AP_SUPPORT=y
BR2_PACKAGE_WPA_SUPPLICANT_WIFI_DISPLAY=y
BR2_PACKAGE_IFUPDOWN=y
BR2_PACKAGE_IFUPDOWN_SCRIPTS=y
BR2_PACKAGE_INITSCRIPTS=y
BR2_PACKAGE_SYSTEMD_ARCH_SUPPORTS=y
BR2_PACKAGE_SYSVINIT=y
BR2_PACKAGE_UTIL_LINUX=y
BR2_PACKAGE_UTIL_LINUX_LIBBLKID=y
BR2_PACKAGE_UTIL_LINUX_LIBMOUNT=y
BR2_PACKAGE_UTIL_LINUX_LIBUUID=y

# SYSTEMV SETUP
BR2_PACKAGE_SKELETON=y
BR2_PACKAGE_HAS_SKELETON=y
BR2_PACKAGE_PROVIDES_SKELETON="skeleton-init-sysv"
BR2_PACKAGE_SKELETON_INIT_COMMON=y
BR2_PACKAGE_SKELETON_INIT_SYSV=y

# V4L2 PACKAGES AND LIBS
BR2_PACKAGE_V4L2GRAB=y
BR2_PACKAGE_V4L2LOOPBACK=y
BR2_PACKAGE_V4L2LOOPBACK_UTILS=y
BR2_PACKAGE_LIBV4L=y
BR2_PACKAGE_LIBV4L_UTILS=y
BR2_PACKAGE_V4L2CPP=y
BR2_PACKAGE_V4L2RTSPSERVER=y

# VIDEO CORE PACKAGES
BR2_PACKAGE_PROVIDES_LIBOPENMAX="rpi-userland"
BR2_PACKAGE_PROVIDES_LIBOPENVG="rpi-userland"

# ADDITIONALY REQUIRED PACKAGES
BR2_PACKAGE_LOG4CPP=y
BR2_PACKAGE_LIVE555=y
BR2_PACKAGE_NODEJS=y
BR2_PACKAGE_NODEJS_NPM=y
BR2_PACKAGE_NODEJS_MODULES_ADDITIONAL="pm2"

# UBOOT BOOTLOADER CONFIG
BR2_PACKAGE_UBOOT_TOOLS=y
BR2_PACKAGE_UBOOT_TOOLS_FWPRINTENV=y
BR2_TARGET_UBOOT=y
BR2_TARGET_UBOOT_BUILD_SYSTEM_LEGACY=y
BR2_TARGET_UBOOT_BOARDNAME="rpi_3_32b"
BR2_TARGET_UBOOT_LATEST_VERSION=y
BR2_TARGET_UBOOT_VERSION="2017.07"
BR2_TARGET_UBOOT_PATCH=""
BR2_TARGET_UBOOT_NEEDS_DTC=y
BR2_TARGET_UBOOT_NEEDS_PYLIBFDT=y
BR2_TARGET_UBOOT_NEEDS_OPENSSL=y
BR2_TARGET_UBOOT_FORMAT_BIN=y
BR2_TARGET_UBOOT_ENVIMAGE=y
BR2_TARGET_UBOOT_ENVIMAGE_SOURCE="board/mbay/rpi3/new.ube"
BR2_TARGET_UBOOT_ENVIMAGE_SIZE="0x4000"
BR2_TARGET_UBOOT_BOOT_SCRIPT=y
BR2_TARGET_UBOOT_BOOT_SCRIPT_SOURCE="board/mbay/rpi3/new.ubs"

# ALSA SOUND LIB CONFIG
BR2_PACKAGE_ALSA_UTILS=y
BR2_PACKAGE_ALSA_LIB_DEVDIR="/dev/snd"
BR2_PACKAGE_ALSA_UTILS_ALSACTL=y
BR2_PACKAGE_ALSA_UTILS_ALSAMIXER=y
BR2_PACKAGE_ALSA_LIB=y
BR2_PACKAGE_ALSA_LIB_ALOAD=y
BR2_PACKAGE_ALSA_LIB_MIXER=y
BR2_PACKAGE_ALSA_LIB_PCM=y
BR2_PACKAGE_ALSA_LIB_RAWMIDI=y
BR2_PACKAGE_ALSA_LIB_HWDEP=y
BR2_PACKAGE_ALSA_LIB_SEQ=y
BR2_PACKAGE_ALSA_LIB_ALISP=y
#BR2_PACKAGE_ALSA_LIB_OLD_SYMBOLS=y

# USER UTILITIES
BR2_PACKAGE_NANO=y
BR2_PACKAGE_NANO_TINY=y
BR2_PACKAGE_VIM=y
BR2_PACKAGE_GIT=y
BR2_PACKAGE_GZIP=y
BR2_PACKAGE_OPENSSH=y
BR2_PACKAGE_BASH=y
BR2_PACKAGE_PROCPS_NG=y
BR2_PACKAGE_CURL=y
BR2_PACKAGE_WGET=y
BR2_PACKAGE_SUDO=y
BR2_PACKAGE_TAR=y
BR2_PACKAGE_GREP=y
BR2_PACKAGE_SED=y

# SWUPDATE REQUIRED PACKAGES
BR2_PACKAGE_COLLECTD=y
BR2_PACKAGE_LIBCURL=y
BR2_PACKAGE_LIBCONFIG=y
BR2_PACKAGE_ZLIB=y
BR2_PACKAGE_SWUPDATE=y
BR2_PACKAGE_SWUPDATE_INSTALL_WEBSITE=y

# SWUPDATED REQUIRED PACKAGES
BR2_PACKAGE_SWUPDATED=y
BR2_PACKAGE_NETCAT_OPENBSD=y
BR2_PACKAGE_EUDEV=y
BR2_PACKAGE_PROVIDES_UDEV="eudev"
BR2_PACKAGE_EUDEV_ENABLE_HWDB=y

# DATABASE PACKAGES
BR2_PACKAGE_REDIS=y
BR2_PACKAGE_SQLITE=y

# BLUETOOTH PACKAGES
BR2_PACKAGE_RPI_BT_FIRMWARE=y
BR2_PACKAGE_BLUEZ_TOOLS=y
BR2_PACKAGE_BLUEZ5_UTILS=y
BR2_PACKAGE_BLUEZ5_UTILS_CLIENT=y
BR2_PACKAGE_BLUEZ5_UTILS_DEPRECATED=y
BR2_PACKAGE_BLUEZ5_PLUGINS_NFC=y
BR2_PACKAGE_BMON=y
BR2_PACKAGE_CONNMAN=y

# TARGET FS GEN
BR2_TARGET_ROOTFS_EXT2=y
BR2_TARGET_ROOTFS_EXT2_4=y
BR2_TARGET_ROOTFS_EXT2_GEN=4
BR2_TARGET_ROOTFS_EXT2_SIZE="393216"
BR2_TARGET_ROOTFS_EXT2_INODES=0
BR2_TARGET_ROOTFS_EXT2_RESBLKS=5
BR2_TARGET_ROOTFS_EXT2_MKFS_OPTIONS="-O ^64bit"
BR2_TARGET_ROOTFS_EXT2_NONE=y

# HOST TOOLING
BR2_PACKAGE_HOST_DOSFSTOOLS=y
BR2_PACKAGE_HOST_GENIMAGE=y
BR2_PACKAGE_HOST_MTOOLS=yBR2_PACKAGE_HOST_DTC=y
BR2_PACKAGE_HOST_MKPASSWD=y
BR2_PACKAGE_HOST_PATCHELF=y
BR2_PACKAGE_HOST_UTIL_LINUX=y
```

## package/safeboot/Config.in
```kconfig
config BR2_PACKAGE_SAFEBOOT
	bool "SafeBoot"
	depends on BR2_TARGET_UBOOT
	help
	  Provides a SafeBoot UBoot system.
```

## package/swupdated/Config.in
```kconfig
comment "SWupdate runner for systemV/udev/node"
config BR2_PACKAGE_SWUPDATED
	bool "SWupdated"
	depends on BR2_PACKAGE_HAS_UDEV
	depends on BR2_PACKAGE_SWUPDATE
	depends on BR2_INIT_SYSV
	select BR2_PACKAGE_NODEJS
	help
	  Provides a daemon to run SWupdate on update files when drives are inserted.
```
